## drivers/input/touchscreen/lge/lgsic/Kconfig
```kconfig
config LGE_TOUCH_LGSIC_LG4946
	bool "LG G5 LG4946 touch controller"
	depends on LGE_TOUCH_CORE && MACH_MSM8996_H1

config LGE_TOUCH_LGSIC_SW49408
	bool "LG SW49408 touchscreen"
	depends on LGE_TOUCH_CORE_BASE && FB_MSM_MDSS
	help
	  Enable the SW49408 controller used by LG G6 devices.

config LGE_TOUCH_LGSIC_LG4945
	bool "LG V20 LG4945 touch controller"
	depends on LGE_TOUCH_CORE && MACH_MSM8996_ELSA

config LGE_TOUCH_LGSIC_SW49407
	bool "LG V20 SW49407 touch controller"
	depends on LGE_TOUCH_CORE && MACH_MSM8996_ELSA
```

## drivers/usb/misc/anx7418/Kconfig
```kconfig
config LGE_USB_ANX7418
	bool "USB Type-C Crosspoint Switch Driver"
	depends on I2C && MACH_MSM8996_H1
	select DUAL_ROLE_USB_INTF
	help
	  Say Y here to add support for analogix ANX7418 Type-C Crosspoint Switch
	  Driver.
```

## drivers/usb/misc/tusb422/Kconfig
```kconfig
config LGE_USB_TYPE_C
	bool "LG MSM8996 Type-C integration"
	depends on ARCH_MSM8996
	help
	  Enable the original LG Type-C power supply and USB role integration.

config TUSB422
	bool "Enable TUSB422 USB Power Delivery"
	depends on I2C
	default n

config TUSB422_PAL
	bool "Enable TUSB422 Platform Abstraction Layer"
	default n
	depends on TUSB422

config LGE_USB_TUSB422
	bool "Enable TUSB422 USB Power Delivery (LGE_USB)"
	depends on LGE_USB_TYPE_C
	select TUSB422

config LGE_USB_TUSB422_PAL
	bool "Enable TUSB422 Platform Abstraction Layer (LGE_USB)"
	depends on LGE_USB_TUSB422
	depends on LGE_USB_TYPE_C
	select TUSB422_PAL
```

## techpack/audio/Kconfig
```kconfig
# SPDX-License-Identifier: GPL-2.0-only
config SND_SOC_MSM8996
	bool "MSM8996 downstream audio"
	depends on ARCH_MSM8996 && SND_SOC && RPMSG_QCOM_SMD
	select SLIMBUS
	select SLIMBUS_MSM_NGD
	select SND_SOC_COMPRESS
	select SND_HWDEP
	select SND_DYNAMIC_MINORS
	select REGMAP
	select REGMAP_I2C
	help
	  Audio support for MSM8996 devices using the downstream APR firmware
	  interface and WCD9335 codec.

if SND_SOC_MSM8996

config SOUNDWIRE_QCOM
	def_bool y

config SND_SOC_WSA881X
	def_bool y

config SND_SOC_WCD9XXX_V2
	def_bool y

config SND_SOC_WCD_MBHC
	def_bool y

config SND_SOC_WCD_CPE
	def_bool y

config SND_SOC_CPE
	def_bool y

config SND_SOC_WCD9335
	def_bool y

config MSM_ADSP_LOADER
	def_bool y

config MSM_QDSP6_SSR
	def_bool y

config MSM_QDSP6_NOTIFIER
	def_bool y

config SND_SOC_MSM_HOSTLESS_PCM
	def_bool y

config SND_SOC_MSM_QDSP6V2_INTF
	def_bool y

config SOUNDWIRE_WCD_CTRL
	def_bool y

config SND_SOC_QDSP6V2
	def_bool y

config WCD9XXX_CODEC_CORE
	def_bool y

config MSM_CDC_PINCTRL
	def_bool y

config SND_SOC_WCD_MBHC_LEGACY
	def_bool y

config QTI_PP
	def_bool y

config SND_HWDEP_ROUTING
	def_bool y

config DOLBY_DS2
	def_bool y

config DTS_SRS_TM
	def_bool y

config SND_SOC_MSM_STUB
	def_bool y

config SND_SOC_MSM_HDMI_CODEC_RX
	def_bool y

config SND_EVENT
	def_bool y

config SND_SOC_ES9018
	bool "LG V20 ESS headphone DAC"
	depends on I2C && MACH_MSM8996_ELSA
	select SND_USE_SEC_MI2S

config SND_SOC_ES9218P
	bool "ESS ES9218P headphone DAC"
	select SND_USE_SEC_MI2S
	depends on I2C

config SND_USE_SEC_MI2S
	bool

config SND_USE_QUAT_MI2S
	bool "Use quaternary MI2S on LG MSM8996"
	depends on ARCH_MSM8996

config SND_USE_SKU_INFO
	bool "Select LG MSM8996 audio calibration by SKU"
	depends on ARCH_MSM8996

config SND_USE_TERT_MI2S
	bool "Use tertiary MI2S for Bluetooth audio"

config MSM_QDSP6_APRV2_RPMSG
	def_bool y

endif
```
